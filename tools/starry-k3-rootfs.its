## tools/starry-k3-rootfs.its
```
/dts-v1/;

/ {
	description = "StarryOS K3 Com260 IFX RAM-rootfs boot image";
	#address-cells = <2>;

	images {
		kernel {
			description = "StarryOS riscv64-k3 kernel (single hart, ram-rootfs)";
			data = /incbin/("../StarryOS_riscv64-k3.bin");
			type = "kernel";
			arch = "riscv";
			os = "linux";
			compression = "none";
			load = <0x1 0x80000000>;
			entry = <0x1 0x80000000>;
			hash-1 {
				algo = "crc32";
			};
		};

		fdt-k3-com260-ifx {
			description = "K3 Com260 IFX device tree (ram-rootfs FDT window 0x2ef000000)";
			data = /incbin/("k3_com260_ifx.dtb");
			type = "flat_dt";
			arch = "riscv";
			compression = "none";
			load = <0x2 0xef000000>;
			hash-1 {
				algo = "crc32";
			};
		};
	};

	configurations {
		default = "conf-starry-k3-rootfs";
		conf-starry-k3-rootfs {
			description = "StarryOS K3 single-hart RAM-rootfs boot";
			kernel = "kernel";
			fdt = "fdt-k3-com260-ifx";
		};
	};
};
```

## tools/starry-k3-smp-combined.its
```
/dts-v1/;

/ {
	description = "StarryOS K3 Com260 IFX multi-hart combined rootfs RAM boot image";
	#address-cells = <2>;

	images {
		kernel {
			description = "StarryOS riscv64-k3 kernel (multi-hart, combined rootfs, MS14)";
			data = /incbin/("../out-k3-smp-combined/StarryOS_riscv64-k3.bin");
			type = "kernel";
			arch = "riscv";
			os = "linux";
			compression = "none";
			load = <0x1 0x80000000>;
			entry = <0x1 0x80000000>;
			hash-1 {
				algo = "crc32";
			};
		};

		fdt-k3-com260-ifx {
			description = "K3 Com260 IFX device tree (combined FDT window 0x2ef000000)";
			data = /incbin/("k3_com260_ifx.dtb");
			type = "flat_dt";
			arch = "riscv";
			compression = "none";
			load = <0x2 0xef000000>;
			hash-1 {
				algo = "crc32";
			};
		};
	};

	configurations {
		default = "conf-starry-k3-smp-combined";
		conf-starry-k3-smp-combined {
			description = "StarryOS K3 multi-hart combined rootfs RAM boot";
			kernel = "kernel";
			fdt = "fdt-k3-com260-ifx";
		};
	};
};
```

## tools/starry-k3-smp-net.its
```
/dts-v1/;

/ {
	description = "StarryOS K3 Com260 IFX multi-hart NIC temporary RAM boot image";
	#address-cells = <2>;

	images {
		kernel {
			description = "StarryOS riscv64-k3 kernel (multi-hart NIC, MS14 Iteration 001)";
			data = /incbin/("../out-k3-smp-net/StarryOS_riscv64-k3.bin");
			type = "kernel";
			arch = "riscv";
			os = "linux";
			compression = "none";
			load = <0x1 0x80000000>;
			entry = <0x1 0x80000000>;
			hash-1 {
				algo = "crc32";
			};
		};

		fdt-k3-com260-ifx {
			description = "K3 Com260 IFX device tree (bootfs k3_com260_ifx.dtb)";
			data = /incbin/("k3_com260_ifx.dtb");
			type = "flat_dt";
			arch = "riscv";
			compression = "none";
			load = <0x1 0x81000000>;
			hash-1 {
				algo = "crc32";
			};
		};
	};

	configurations {
		default = "conf-starry-k3-smp-net";
		conf-starry-k3-smp-net {
			description = "StarryOS K3 multi-hart NIC steady-state RAM boot";
			kernel = "kernel";
			fdt = "fdt-k3-com260-ifx";
		};
	};
};
```

## tools/starry-k3-smp-uart-raw.its
```
/dts-v1/;

/ {
	description = "StarryOS K3 Com260 IFX multi-hart raw UART temporary RAM boot image";
	#address-cells = <2>;

	images {
		kernel {
			description = "StarryOS riscv64-k3 kernel (multi-hart raw UART, MS14 Iteration 002)";
			data = /incbin/("../out-k3-smp-uart-raw/StarryOS_riscv64-k3.bin");
			type = "kernel";
			arch = "riscv";
			os = "linux";
			compression = "none";
			load = <0x1 0x80000000>;
			entry = <0x1 0x80000000>;
			hash-1 {
				algo = "crc32";
			};
		};

		fdt-k3-com260-ifx {
			description = "K3 Com260 IFX device tree (bootfs k3_com260_ifx.dtb)";
			data = /incbin/("k3_com260_ifx.dtb");
			type = "flat_dt";
			arch = "riscv";
			compression = "none";
			load = <0x1 0x81000000>;
			hash-1 {
				algo = "crc32";
			};
		};
	};

	configurations {
		default = "conf-starry-k3-smp-uart-raw";
		conf-starry-k3-smp-uart-raw {
			description = "StarryOS K3 multi-hart raw UART RAM boot";
			kernel = "kernel";
			fdt = "fdt-k3-com260-ifx";
		};
	};
};
```

## tools/starry-k3-smp.its
```
/dts-v1/;

/ {
	description = "StarryOS K3 Com260 IFX multi-hart temporary RAM boot image";
	#address-cells = <2>;

	images {
		kernel {
			description = "StarryOS riscv64-k3 kernel (multi-hart, MS14)";
			data = /incbin/("../out-k3-smp/StarryOS_riscv64-k3.bin");
			type = "kernel";
			arch = "riscv";
			os = "linux";
			compression = "none";
			load = <0x1 0x80000000>;
			entry = <0x1 0x80000000>;
			hash-1 {
				algo = "crc32";
			};
		};

		fdt-k3-com260-ifx {
			description = "K3 Com260 IFX device tree (bootfs k3_com260_ifx.dtb)";
			data = /incbin/("k3_com260_ifx.dtb");
			type = "flat_dt";
			arch = "riscv";
			compression = "none";
			load = <0x1 0x81000000>;
			hash-1 {
				algo = "crc32";
			};
		};
	};

	configurations {
		default = "conf-starry-k3-smp";
		conf-starry-k3-smp {
			description = "StarryOS K3 multi-hart native platform RAM boot";
			kernel = "kernel";
			fdt = "fdt-k3-com260-ifx";
		};
	};
};
```

## tools/starry-k3.its
```
/dts-v1/;

/ {
	description = "StarryOS K3 Com260 IFX temporary RAM boot image";
	#address-cells = <2>;

	images {
		kernel {
			description = "StarryOS riscv64-k3 kernel (single hart)";
			data = /incbin/("../StarryOS_riscv64-k3.bin");
			type = "kernel";
			arch = "riscv";
			os = "linux";
			compression = "none";
			load = <0x1 0x80000000>;
			entry = <0x1 0x80000000>;
			hash-1 {
				algo = "crc32";
			};
		};

		fdt-k3-com260-ifx {
			description = "K3 Com260 IFX device tree (bootfs k3_com260_ifx.dtb)";
			data = /incbin/("k3_com260_ifx.dtb");
			type = "flat_dt";
			arch = "riscv";
			compression = "none";
			load = <0x1 0x81000000>;
			hash-1 {
				algo = "crc32";
			};
		};
	};

	configurations {
		default = "conf-starry-k3";
		conf-starry-k3 {
			description = "StarryOS K3 single-hart first-byte RAM boot";
			kernel = "kernel";
			fdt = "fdt-k3-com260-ifx";
		};
	};
};
```
